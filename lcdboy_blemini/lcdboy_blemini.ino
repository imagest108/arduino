#include <SPI.h> // We'll use SPI to transfer data. Faster!

#include <Arduino.h>
#include <SoftwareSerial.h>

/* PCD8544-specific defines: */
#define LCD_COMMAND  0 
#define LCD_DATA     1

/* 84x48 LCD Defines: */
#define LCD_WIDTH   84 // Note: x-coordinates go wide
#define LCD_HEIGHT  48 // Note: y-coordinates go high

// http://redbearlab.com/blemini/
//BLE Mini is connected to pin 2 and 3.
SoftwareSerial BLEMini(2, 3);

/* Pin definitions: 
Most of these pins can be moved to any digital or analog pin.
DN(MOSI)and SCLK should be left where they are (SPI pins). The 
LED (backlight) pin should remain on a PWM-capable pin. */
const int scePin = 9;   // SCE - Chip select, pin 3 on LCD.
const int rstPin = 8;   // RST - Reset, pin 4 on LCD.
const int dcPin =  5;    // DC - Data/Command, pin 5 on LCD.
const int sdinPin = 11;  // DN(MOSI) - Serial data, pin 6 on LCD.
const int sclkPin = 13;  // SCLK - Serial clock, pin 7 on LCD.
const int blPin = 6;    // LED - Backlight LED, pin 8 on LCD.
const int pingPin = 0;

byte displayMap[LCD_WIDTH * LCD_HEIGHT / 8] = {

};

char normal[504] = {
0x00, 0x00, 0x00, 0x00, 0x00, 0x00, 0x00, 0x00, 0x00, 0x00, 0x00, 0x00, 0x00, 0x00, 0x00, 0x00,
0x00, 0x00, 0x00, 0x00, 0x00, 0x00, 0x00, 0x00, 0x00, 0x00, 0x00, 0x00, 0x00, 0x00, 0x00, 0x00,
0x00, 0x00, 0x00, 0x00, 0x00, 0x00, 0x00, 0x00, 0x00, 0x00, 0x00, 0x00, 0x00, 0x00, 0x00, 0x00,
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0x00, 0x00, 0x00, 0x00, 0x00, 0x00, 0x00, 0x00, 
};

char bigSmile[504] = {
0x00, 0x00, 0x00, 0x00, 0x00, 0x00, 0x00, 0x00, 0x00, 0x00, 0x00, 0x00, 0x00, 0x00, 0x00, 0x00,
0x00, 0x00, 0x00, 0x00, 0x00, 0x00, 0x00, 0x00, 0x00, 0x00, 0x00, 0x00, 0x00, 0x00, 0x00, 0x00,
0x00, 0x00, 0x00, 0x00, 0x00, 0x00, 0x00, 0x00, 0x00, 0x00, 0x00, 0x00, 0x00, 0x00, 0x00, 0x00,
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0x00, 0x00, 0x00, 0x00, 0x00, 0x00, 0x00, 0x00, 
};

int foundUser = 0; 
int _foundUser = 1; 
bool startToTalk = false;


void setup() {
  BLEMini.begin(57600);
  Serial.begin(57600);
  Serial.println("\nChat BLEMini Version\n");
  
  lcdBegin(); // This will setup our pins, and initialize the LCD
  setContrast(55); // Pretty good value, play around with it
  setBitmap(normal);
  updateDisplay();
}

unsigned char buf[16] = {0};
unsigned char len = 0;

void loop() {
  
  checkProximity();
  if(foundUser != _foundUser){
    switch(foundUser)
    {    
      case 0: //normal face
        setBitmap(normal);
        updateDisplay();
        BLEMini.write("0");
        BLEMini.write(0xA);
      break; 
      case 1: //normal face
        setBitmap(bigSmile);
        updateDisplay();
        BLEMini.write("1");
        BLEMini.write(0xA);
      break;
      }

    }
  _foundUser = foundUser;
  
//  if (BLEMini.available()) {
//    
//    if(!startToTalk) Serial.println("lcd bot is ready to talk!");
//    startToTalk = true;
//    Serial.write("Them: ");
//    while (BLEMini.available()) {
//      Serial.write(BLEMini.read());
//    }
//  }
  
  while (Serial.available()) {
    unsigned char c = Serial.read();
    if (c == 0xA || c == 0xD) { // \n or \r
      sendData();
    } else {
      bufferData(c);
    }
    if(startToTalk){

    }
  }
}

void bufferData(char c) {
  if (len < 16) {
    buf[len++] = c;
  } // TODO warn, or send data
}

void sendData() {
  Serial.write("Us: ");
  for (int i = 0; i < len; i++) {
    BLEMini.write(buf[i]);
    Serial.write(buf[i]);
  }
  BLEMini.write(0xA);
  Serial.write(0xA); // TODO test on windows
  len = 0;  
}

//This sends the magical commands to the PCD8544
void lcdBegin(void) 
{
  //Configure control pins
  pinMode(scePin, OUTPUT);
  pinMode(rstPin, OUTPUT);
  pinMode(dcPin, OUTPUT);
  pinMode(sdinPin, OUTPUT);
  pinMode(sclkPin, OUTPUT);
  pinMode(blPin, OUTPUT);
  analogWrite(blPin, 255);

  SPI.begin();
  SPI.setDataMode(SPI_MODE0);
  SPI.setBitOrder(MSBFIRST);

  //Reset the LCD to a known state
  digitalWrite(rstPin, LOW);
  digitalWrite(rstPin, HIGH);

  LCDWrite(LCD_COMMAND, 0x21); //Tell LCD extended commands follow
  LCDWrite(LCD_COMMAND, 0xB0); //Set LCD Vop (Contrast)
  LCDWrite(LCD_COMMAND, 0x04); //Set Temp coefficent
  LCDWrite(LCD_COMMAND, 0x14); //LCD bias mode 1:48 (try 0x13)
  //We must send 0x20 before modifying the display control mode
  LCDWrite(LCD_COMMAND, 0x20); 
  LCDWrite(LCD_COMMAND, 0x0C); //Set display control, normal mode.
}
// This function clears the entire display either white (0) or
// black (1).
// The screen won't actually clear until you call updateDisplay()!
void clearDisplay(boolean bw)
{
  for (int i=0; i<(LCD_WIDTH * LCD_HEIGHT / 8); i++)
  {
    if (bw)
      displayMap[i] = 0xFF;
    else
      displayMap[i] = 0;
  }
}

// Helpful function to directly command the LCD to go to a 
// specific x,y coordinate.
void gotoXY(int x, int y)
{
  LCDWrite(0, 0x80 | x);  // Column.
  LCDWrite(0, 0x40 | y);  // Row.  ?
}

void updateDisplay()
{
  gotoXY(0, 0);
  for (int i=0; i < (LCD_WIDTH * LCD_HEIGHT / 8); i++)
  {
    LCDWrite(LCD_DATA, displayMap[i]);
  }
}

void setBitmap(char * bitArray)
{
  for (int i=0; i<(LCD_WIDTH * LCD_HEIGHT / 8); i++)
    displayMap[i] = bitArray[i];
}


// Set contrast can set the LCD Vop to a value between 0 and 127.
// 40-60 is usually a pretty good range.
void setContrast(byte contrast)
{  
  LCDWrite(LCD_COMMAND, 0x21); //Tell LCD that extended commands follow
  LCDWrite(LCD_COMMAND, 0x80 | contrast); //Set LCD Vop (Contrast): Try 0xB1(good @ 3.3V) or 0xBF if your display is too dark
  LCDWrite(LCD_COMMAND, 0x20); //Set display mode
}

// There are two memory banks in the LCD, data/RAM and commands.
// This function sets the DC pin high or low depending, and then 
// sends the data byte
void LCDWrite(byte data_or_command, byte data) 
{
  //Tell the LCD that we are writing either to data or a command
  digitalWrite(dcPin, data_or_command); 

  //Send the data
  digitalWrite(scePin, LOW);
  SPI.transfer(data); //shiftOut(sdinPin, sclkPin, MSBFIRST, data);
  digitalWrite(scePin, HIGH);
}

void checkProximity(){
  
  int val = analogRead(pingPin);
  //Serial.println(val);
  
  
  if(val > 150) {
    //Serial.println("Hello");
    foundUser = 1;
  }else{
    foundUser = 0;
  }

  delay(200);
}
